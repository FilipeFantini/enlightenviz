## examples/earthquakes-vega/board.yml
```yaml
# The earthquakes board, with every chart written in Vega-Lite. The data is
# invented and lives in ../earthquakes/schema.sql. The same board written for
# Apache ECharts is ../earthquakes-echarts/board.yml; they differ only in the
# chart specifications. The format is described in docs/boards.md.
board: earthquakes-vega
title: Earthquakes, January 2024
text: Invented data, for trying the server out.

filters:
  - label: From
    param: from
    control: date
  - label: Regions
    param: regions
    control: multiselect
    options_from: {query: regions, value: value, label: label}
  - label: Magnitude class
    param: min_magnitude
    control: select
    options:
      - {value: 0, label: All classes}
      - {value: 4, label: "4 and above"}
      - {value: 5, label: "5 and above"}
      - {value: 6, label: "6 and over"}

stats:
  - {label: Events, query: summary, value: events, format: integer, hero: true}
  - {label: Strongest, query: summary, value: strongest, format: one_decimal}
  - {label: Average depth (km), query: summary, value: depth, format: integer}
  - {label: Regions hit, query: summary, value: regions, format: integer}

queries:
  regions:
    sql: |
      select region as value, region as label
      from earthquake_events
      group by region
      order by region

  summary:
    sql: |
      select count(*) as events,
             max(magnitude) as strongest,
             round(avg(depth_km)) as depth,
             count(distinct region) as regions
      from earthquake_events
      where day >= $from
        and region = any($regions)
        and magnitude >= $min_magnitude
    params:
      from: {type: date, default: "2024-01-01"}
      regions: {type: "list<text>", default: [Aegean, Andes, Cascadia, Hokkaido, Rift Valley, Tonga]}
      min_magnitude: {type: number, default: 0}

  daily:
    sql: |
      with days as (
        select d::date as day
        from generate_series($from::date, (select max(day) from earthquake_events), interval '1 day') as d
      )
      select days.day,
             count(e.event_id) filter (where e.magnitude < 4) as "Under 4",
             count(e.event_id) filter (where e.magnitude >= 4 and e.magnitude < 5) as "4 to 5",
             count(e.event_id) filter (where e.magnitude >= 5 and e.magnitude < 6) as "5 to 6",
             count(e.event_id) filter (where e.magnitude >= 6) as "6 and over"
      from days
      left join earthquake_events e
        on e.day = days.day
       and e.region = any($regions)
       and e.magnitude >= $min_magnitude
      group by days.day
      order by days.day
    params:
      from: {type: date, default: "2024-01-01"}
      regions: {type: "list<text>", default: [Aegean, Andes, Cascadia, Hokkaido, Rift Valley, Tonga]}
      min_magnitude: {type: number, default: 0}

  by_region:
    sql: |
      select region, count(*) as events
      from earthquake_events
      where day >= $from
        and region = any($regions)
        and magnitude >= $min_magnitude
      group by region
      order by events desc, region
    params:
      from: {type: date, default: "2024-01-01"}
      regions: {type: "list<text>", default: [Aegean, Andes, Cascadia, Hokkaido, Rift Valley, Tonga]}
      min_magnitude: {type: number, default: 0}

  events:
    sql: |
      select event_id::text as event,
             region || ', ' || to_char(day, 'FMDD Mon') as place,
             magnitude, depth_km, latitude, longitude
      from earthquake_events
      where day >= $from
        and region = any($regions)
        and magnitude >= $min_magnitude
      order by magnitude desc, event_id
    params:
      from: {type: date, default: "2024-01-01"}
      regions: {type: "list<text>", default: [Aegean, Andes, Cascadia, Hokkaido, Rift Valley, Tonga]}
      min_magnitude: {type: number, default: 0}

charts:
  - title: Events a day, by magnitude class
    query: daily
    palette: ordered
    vega_lite:
      mark: bar
      transform:
        - {fold: ["Under 4", "4 to 5", "5 to 6", "6 and over"], as: [class, events]}
        - {calculate: "indexof(['Under 4', '4 to 5', '5 to 6', '6 and over'], datum.class)", as: rank}
      encoding:
        x: {field: day, type: temporal, timeUnit: yearmonthdate, title: null, axis: {format: "%-d %b"}}
        y: {field: events, type: quantitative, title: null}
        color:
          field: class
          type: ordinal
          title: null
          scale: {domain: ["Under 4", "4 to 5", "5 to 6", "6 and over"]}
          sort: ["Under 4", "4 to 5", "5 to 6", "6 and over"]
        order: {field: rank, type: quantitative}
        tooltip:
          - {field: events, type: quantitative, title: Events}
          - {field: class, type: ordinal, title: Magnitude}
          - {field: day, type: temporal, timeUnit: yearmonthdate, title: Day, format: "%-d %B"}

  - title: Events by region
    query: by_region
    vega_lite:
      encoding:
        y: {field: region, type: nominal, sort: null, title: null}
        x: {field: events, type: quantitative, title: null}
      layer:
        - mark: bar
          encoding:
            tooltip:
              - {field: events, type: quantitative, title: Events}
              - {field: region, type: nominal, title: Region}
        - mark: {type: text, align: left, dx: 6}
          encoding:
            text: {field: events, type: quantitative}

  - title: Where they happened
    query: events
    vega_lite:
      padding: {left: 16, right: 16, top: 16, bottom: 16}
      projection: {type: equirectangular}
      layer:
        - data: {name: world}
          mark: geoshape
        - mark: circle
          encoding:
            longitude: {field: longitude, type: quantitative}
            latitude: {field: latitude, type: quantitative}
            size: {field: magnitude, type: quantitative, legend: null, scale: {type: sqrt, domain: [2.5, 7.5], range: [64, 800]}}
        # An invisible circle of 24 px over each point: the hit area.
        - mark: {type: circle, opacity: 0}
          encoding:
            longitude: {field: longitude, type: quantitative}
            latitude: {field: latitude, type: quantitative}
            size: {value: 576}
            tooltip:
              - {field: magnitude, type: quantitative, title: Magnitude, format: ".1f"}
              - {field: place, type: nominal, title: Place}
              - {field: depth_km, type: quantitative, title: Depth (km)}
```

## examples/earthquakes/board.yml
```yaml
# The example board: filters, stats and three charts over invented data, which
# lives in schema.sql beside this file. The format is described in
# docs/boards.md.
board: earthquakes
title: Earthquakes, January 2024
text: Invented data, for trying the server out.

filters:
  - label: From
    param: from
    control: date
  - label: Regions
    param: regions
    control: multiselect
    options_from: {query: regions, value: value, label: label}
  - label: Magnitude class
    param: min_magnitude
    control: select
    options:
      - {value: 0, label: All classes}
      - {value: 4, label: "4 and above"}
      - {value: 5, label: "5 and above"}
      - {value: 6, label: "6 and over"}

stats:
  - {label: Events, query: summary, value: events, format: integer, hero: true}
  - {label: Strongest, query: summary, value: strongest, format: one_decimal}
  - {label: Average depth (km), query: summary, value: depth, format: integer}
  - {label: Regions hit, query: summary, value: regions, format: integer}

queries:
  regions:
    sql: |
      select region as value, region as label
      from earthquake_events
      group by region
      order by region

  summary:
    sql: |
      select count(*) as events,
             max(magnitude) as strongest,
             round(avg(depth_km)) as depth,
             count(distinct region) as regions
      from earthquake_events
      where day >= $from
        and region = any($regions)
        and magnitude >= $min_magnitude
    params:
      from: {type: date, default: "2024-01-01"}
      regions: {type: "list<text>", default: [Aegean, Andes, Cascadia, Hokkaido, Rift Valley, Tonga]}
      min_magnitude: {type: number, default: 0}

  daily:
    sql: |
      with days as (
        select d::date as day
        from generate_series($from::date, (select max(day) from earthquake_events), interval '1 day') as d
      )
      select days.day,
             count(e.event_id) filter (where e.magnitude < 4) as "Under 4",
             count(e.event_id) filter (where e.magnitude >= 4 and e.magnitude < 5) as "4 to 5",
             count(e.event_id) filter (where e.magnitude >= 5 and e.magnitude < 6) as "5 to 6",
             count(e.event_id) filter (where e.magnitude >= 6) as "6 and over"
      from days
      left join earthquake_events e
        on e.day = days.day
       and e.region = any($regions)
       and e.magnitude >= $min_magnitude
      group by days.day
      order by days.day
    params:
      from: {type: date, default: "2024-01-01"}
      regions: {type: "list<text>", default: [Aegean, Andes, Cascadia, Hokkaido, Rift Valley, Tonga]}
      min_magnitude: {type: number, default: 0}

  by_region:
    sql: |
      select region, count(*) as events
      from earthquake_events
      where day >= $from
        and region = any($regions)
        and magnitude >= $min_magnitude
      group by region
      order by events desc, region
    params:
      from: {type: date, default: "2024-01-01"}
      regions: {type: "list<text>", default: [Aegean, Andes, Cascadia, Hokkaido, Rift Valley, Tonga]}
      min_magnitude: {type: number, default: 0}

  events:
    sql: |
      select event_id::text as event,
             region || ', ' || to_char(day, 'FMDD Mon') as place,
             magnitude, depth_km, latitude, longitude
      from earthquake_events
      where day >= $from
        and region = any($regions)
        and magnitude >= $min_magnitude
      order by magnitude desc, event_id
    params:
      from: {type: date, default: "2024-01-01"}
      regions: {type: "list<text>", default: [Aegean, Andes, Cascadia, Hokkaido, Rift Valley, Tonga]}
      min_magnitude: {type: number, default: 0}

charts:
  - title: Events a day, by magnitude class
    query: daily
    palette: ordered
    echarts:
      tooltip: {trigger: axis}
      xAxis: {type: time, axisLabel: {formatter: "{d} {MMM}"}}
      yAxis: {type: value}
      series:
        - {type: bar, name: "Under 4", stack: events, barWidth: "90%", encode: {x: day, y: "Under 4"}}
        - {type: bar, name: "4 to 5", stack: events, barWidth: "90%", encode: {x: day, y: "4 to 5"}}
        - {type: bar, name: "5 to 6", stack: events, barWidth: "90%", encode: {x: day, y: "5 to 6"}}
        - {type: bar, name: "6 and over", stack: events, barWidth: "90%", encode: {x: day, y: "6 and over"}}

  - title: Events by region
    query: by_region
    echarts:
      tooltip: {trigger: item}
      xAxis: {type: value}
      yAxis: {type: category, inverse: true}
      series:
        - type: bar
          name: Events
          encode: {x: events, y: region}
          label: {show: true, position: right}

  - title: Where they happened
    query: events
    echarts:
      tooltip: {trigger: item}
      geo: {map: world, roam: false, silent: true}
      visualMap:
        show: false
        dimension: magnitude
        min: 2.5
        max: 7.5
        seriesIndex: 0
        inRange: {symbolSize: [8, 28]}
      series:
        - type: scatter
          coordinateSystem: geo
          encode: {lng: longitude, lat: latitude, value: magnitude}
        # An invisible symbol of 24 px over each point: the hit area.
        - type: scatter
          coordinateSystem: geo
          symbolSize: 24
          itemStyle: {opacity: 0}
          emphasis: {disabled: true}
          encode: {lng: longitude, lat: latitude, value: magnitude, tooltip: [magnitude, place, depth_km]}
```

## tests/fixtures/api/board.yml
```yaml
# The board the HTTP tests run against; the data is in examples/earthquakes.
board: api
title: API tests
queries:
  by_region:
    sql: |
      select day, events
      from earthquakes_daily
      where region = $region and day >= $from
      order by day
    params:
      region: {type: text}
      from: {type: date, default: "2024-01-01"}
  echo:
    sql: select $text as text, $number as number, $flag as flag, $date as date, $items as items
    params:
      text: {type: text}
      number: {type: number}
      flag: {type: boolean}
      date: {type: date}
      items: {type: "list<integer>", max_items: 3}
  slow:
    sql: select 1 as one from pg_sleep($seconds)
    params:
      seconds: {type: number}
  many:
    sql: select n from generate_series(1, $count) as n
    params:
      count: {type: integer}
  column_named_like_the_alias:
    sql: select 7 as q
charts:
  - title: Events
    query: by_region
    vega_lite:
      mark: line
      encoding:
        x: {field: day, type: temporal}
        y: {field: events, type: quantitative}
```
